## nrf_connect_Implementation/boards/arm/caretronic_nrf52840/Kconfig.board
```kconfig
# nRF52840 DK NRF52840 board configuration

# Copyright (c) 2016 Nordic Semiconductor ASA
# SPDX-License-Identifier: Apache-2.0

config BOARD_CARETRONIC_NRF52840
	bool "caretronic nRF52840"
	depends on SOC_NRF52840_QIAA
```
